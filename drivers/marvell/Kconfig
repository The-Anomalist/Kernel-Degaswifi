## drivers/marvell/Kconfig
```kconfig
menuconfig MARVELL_DRIVERS
	bool "Marvell kernel module drivers"
	help
		marvell kernel module drivers

if MARVELL_DRIVERS

config MRVL_WIRELESS
	bool "marvell wireless driver"
	---help---
	This enables the marvell wireless driver for application processor

choice
	depends on MRVL_WIRELESS
	bool "Choose the chip for marvell wireless"
	default MRVL_WL_SD8777

config MRVL_WL_SD8777
	bool "SD8777"
	---help---
	Marvell NIC driver: SD8777 chip

config MRVL_WL_SD8787
	bool "SD8787"
	---help---
	Marvell NIC driver: SD8787 chip

config MRVL_WL_SD8887
	bool "SD8887"
	---help---
	Marvell NIC driver: SD8887 chip

config MRVL_WL_SD8897
	bool "SD8897"
	---help---
	Temporarily maintain SD8897 specifically, this item will be
	removed when Marvell combo driver support SD8897

config MRVL_WL_SD8XXX
	bool "SD8787/SD8777/SD8801/SD8887"
	---help---
	Marvell combo driver support: SD8787/SD8777/SD8801/SD8887 chips

endchoice

config MRVL_WL_BUILD_TYPE
	depends on MRVL_WL_SD8777 || MRVL_WL_SD8787 || MRVL_WL_SD8887 || MRVL_WL_SD8897 || (MRVL_WL_SD8XXX && m)
	tristate "Build type of the driver for MARVELL wireless"
	default m
	---help---
	Choose <m> if you want to build the driver as module;
	<y> to build-in kernel; <n> if you do not want to build.

config MRVL_GPU_GALCORE
	tristate "Marvell Graphics Kernel Mode Driver"
	default n
	help
		If you say Y here, graphics kernel mode driver named galcore
		will be built into uImage.

		To compile this driver as a module, choose M here: the driver
		will be compiled into a separate module galcore.ko.

		If you want to disable GPU hardware totally, just select N here.

config MRVL_MMP_MODEM
       tristate "Marvell mmp modem driver"
       default n
       help
               marvell mmp modem driver for communication processor

config SSIPC_SUPPORT
       bool "SSIPC feature"
	   depends on MRVL_MMP_MODEM
       default n
       help
               support SSIPC feature

config MRVL_GEU
       tristate "Marvell driver for generic encrypt unit"
       default n
       help
               driver for generic encrypt unit

config GRAPHICS_PXA1920
	tristate "enable graphics for pxa1920"
	help
		Say Y here to enable the support of graphics core
		for chipset pxa1920

config GRAPHICS_PXA1088
	tristate "enable graphics for pxa1088"
	help
		Say Y here to enable the support of graphics core
		for chipset pxa1088

config MRVL_TZDD
       tristate "Marvell Trust Zone Device Driver"
       default n
       help
               Marvell Trust Execution Environment (TEE) Solution in non-trusted world

config SEC_GPU_FREQ_CONTROL
       bool "SEC specific user control for GPU"
       depends on MRVL_GPU_GALCORE
       default n
       help
               Enabling this will provide sys fs nodes for GPU frequency control from
	       user space required for CFMS.

endif
```
